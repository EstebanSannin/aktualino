## components/aktualino_berry/Kconfig
```kconfig
menu "Aktualino script secondary (Berry)"

config AKTUALINO_SCRIPT_SECONDARY
    bool "Enable the Berry script secondary (Uptane-signed on-device plugins)"
    default n
    help
        Build the optional Berry script-secondary feature
        (docs/berry-secondary-spec.md): a second, independently-versioned Uptane
        target track that delivers small Berry scripts to a LittleFS partition and
        runs them as a virtual secondary ECU (hardware id "aktualino-lua").

        When DISABLED (the default), none of the Berry runtime or script components
        are compiled, no scripts partition or second ECU exists, and the firmware
        is byte-identical to a build without the feature. Enable it (e.g. per-target
        for the ESP32-S3) to opt in.

        This single switch gates both the aktualino_berry (VM) and, later,
        aktualino_script (secondary logic) components.

endmenu
```

## main/Kconfig.projbuild
```kconfig
menu "Aktualino"

    menu "WiFi (fallback credentials)"
        comment "Primary source is main/wifi_credentials.h, generated by tools/sync-build.sh from secrets/wifi.env. These Kconfig values are a backup used only when that header is absent."

        config AKTUALINO_WIFI_SSID
            string "WiFi SSID (fallback)"
            default "aktualino-dev"
            help
                Fallback SSID, used only when main/wifi_credentials.h is not
                present. Real dev creds come from secrets/wifi.env via
                tools/sync-build.sh. Never commit real credentials here.

        config AKTUALINO_WIFI_PASS
            string "WiFi password (fallback)"
            default ""
            help
                Fallback WiFi password. See AKTUALINO_WIFI_SSID.
    endmenu

    config AKTUALINO_SNTP_SERVER
        string "SNTP server"
        default "pool.ntp.org"
        help
            NTP server used at boot for secure time (SPEC §9). Uptane expiry
            checks are meaningless without trustworthy time.

    config AKTUALINO_OTA_URL
        string "Phase-0 OTA image URL"
        default "https://192.168.1.100:8443/firmware.bin"
        help
            HTTPS URL of the firmware image served by the Phase-0 dumb update
            server (tools/dumb-update-server.py) on the build host — a dev
            convenience predating Torizon Cloud. Set this to your own server's
            LAN address. (No per-server CA is embedded; the server's TLS cert
            must chain to the compiled-in Mozilla CA bundle.)

endmenu
```
